ENTRY(kernel_entry)

SECTIONS {
    . = 0x8000;  /* Endereço onde o bootloader salta */

    .text : ALIGN(4096) {
        *(.text)
    }

    .rodata : ALIGN(4096) {
        *(.rodata)
    }

    .data : ALIGN(4096) {
        *(.data)
    }

    .bss : ALIGN(4096) {
        *(COMMON)
        *(.bss)
    }
}

